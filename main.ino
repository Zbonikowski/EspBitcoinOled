#define TCP_MSS 1
#define LWIP_IPV6 1
#define LWIP_FEATURES 1
#define LWIP_OPEN_SRC 1

#include <ArduinoJson.h>

#include <ESP8266WiFi.h>
#include <WiFiClientSecure.h> 

#include <Wire.h>
#include <Adafruit_GFX.h>
#include <Adafruit_SSD1306.h>

#include "time.h"

#define SCREEN_WIDTH 128 // OLED display width, in pixels
#define SCREEN_HEIGHT 64 // OLED display height, in pixels



// Declaration for an SSD1306 display connected to I2C (SDA, SCL pins)
Adafruit_SSD1306 display(SCREEN_WIDTH, SCREEN_HEIGHT, &Wire, -1);


const char* ntpServer = "pool.ntp.org";
const long  gmtOffset_sec = 0;
const int   daylightOffset_sec = 3600;

/* Set these to your desired credentials. */
const char *ssid = "your ssid";  //ENTER YOUR WIFI SETTINGS
const char *password = "your pass";
const char* linia = "";

const char *host = "query1.finance.yahoo.com";
const int httpsPort = 443;  //HTTPS= 443 and HTTP = 80
int oldCena = 0;
int rmin = 0;
int rmax = 0;
int roznica = 0;

const char fingerprint[] PROGMEM = "e15e35d59c831eb0fa91761462b7d48f5411363811";

const unsigned char myBitmap [] PROGMEM = {
  0x00, 0x00, 0x00, 0x00, 0x00, 0x00, 0x00, 0x00, 0x00, 0x00, 0x00, 0x00, 0x00, 0x00, 0x00, 0x00, 
  0x00, 0x00, 0x00, 0x00, 0x00, 0x00, 0x00, 0x00, 0x00, 0x00, 0x00, 0x00, 0x00, 0x00, 0x00, 0x00, 
  0x00, 0x00, 0x00, 0x00, 0x00, 0x00, 0x00, 0x00, 0x00, 0x00, 0x00, 0x00, 0x00, 0x00, 0x00, 0x00, 
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  0x00, 0x00, 0x00, 0x00, 0x00, 0x00, 0x00, 0x3f, 0xfc, 0x00, 0x00, 0x00, 0x00, 0x00, 0x00, 0x00
};



void setup() {
  delay(1000);
  Serial.begin(115200);
  WiFi.mode(WIFI_OFF);
  delay(1000);
  WiFi.mode(WIFI_STA);

  if(!display.begin(SSD1306_SWITCHCAPVCC, 0x3C)) { // Address
    Serial.println(F("SSD1306 allocation failed"));
    for(;;);
  }
  WiFi.begin(ssid, password);     //Connect
  Serial.println("");
  display.clearDisplay();
  display.drawBitmap(0, 0, myBitmap, 128, 64, WHITE); 
  display.setTextColor(WHITE);
  display.setCursor(0, 10);
  display.setTextSize(1);
  Serial.print("Connecting");
  display.print("Connecting");
  display.display(); 
  
  // Wait for connection
  while (WiFi.status() != WL_CONNECTED) {
    delay(1000);
    Serial.print(".");
    display.print(".");
    display.display(); 
  }

  //show ip address on serial
  Serial.println("");
  Serial.print("Connected to ");
  Serial.println(ssid);
  Serial.print("IP address: ");
  Serial.println(WiFi.localIP());
  
  configTime(1 * 3600, 0, "tempus1.gum.gov.pl");
  Serial.println("\nWaiting for time");
  while (!time(nullptr)) {
    Serial.print(".");
    delay(1000);
  }
  Serial.println("");
}

void loop() {
    BearSSL::WiFiClientSecure httpsClient;
    httpsClient.setInsecure();

  
    display.setTextColor(WHITE);
    display.setCursor(90, 55);
    display.setTextSize(1);
    display.print(".");
    display.display(); 
    httpsClient.setFingerprint(fingerprint);
    httpsClient.setTimeout(15000); // 15 Seconds
    delay(1000);
    
    int r=0; //retry
    while((!httpsClient.connect(host, httpsPort)) && (r < 30)){
        delay(100);
        display.print(".");
        display.display(); 
        r++;
    }
    if(r==30) {
      Serial.println("Connection failed");
    }
    else {
      Serial.println("Connected to web");
    }
    
    String getData, Link;
    Link = "/v7/finance/quote?&symbols=BTC-USD&fields=regularMarketPrice,regularMarketVolume,volume";
  
    display.print(".");
    display.display(); 
    
    httpsClient.print(String("GET ") + Link + " HTTP/1.1\r\n" +
                 "Host: " + host + "\r\n" +               
                 "Connection: close\r\n\r\n");
  
    display.print(">");
    display.display();                 
    while (httpsClient.connected()) {
      String line = httpsClient.readStringUntil('\n');
      if (line == "\r") {
        display.print("<");
        display.display(); 
        break;
      }
    }
  
    String line;
    while(httpsClient.available()){        
      line = httpsClient.readStringUntil('\n');
      //Serial.println(line);
      display.print(".");
      display.display(); 
    }
  
    httpsClient.stop();
    const size_t capacity = JSON_ARRAY_SIZE(1) + JSON_OBJECT_SIZE(1) + JSON_OBJECT_SIZE(2) + JSON_OBJECT_SIZE(21) + 490;
    DynamicJsonDocument doc(capacity);
  
    const char* json = line.c_str();
  
    deserializeJson(doc, json);
  
    JsonObject quoteResponse_result_0 = doc["quoteResponse"]["result"][0];
    String cena = quoteResponse_result_0["regularMarketPrice"];
    String volume = quoteResponse_result_0["regularMarketVolume"];
    int newCena = cena.toInt();

    int roznica = newCena-oldCena;
    
    
  time_t rawtime;
  struct tm * timeinfo;
  char buffer [80];

  time (&rawtime);
  timeinfo = localtime (&rawtime);
  
  //Serial.println(newCena);  
  display.clearDisplay();

  display.setTextSize(2);
  display.setCursor(0, 10);
  
  // Display static text
  display.print(newCena);
  if(roznica == 0){
    display.println(" - ");
  }else if(roznica >= 1) {
    if(roznica>rmax and oldCena!=0){
      rmax=roznica;
    }
    display.println(" / ");
  }else{
    display.println(" \\ ");
    if(roznica<rmin){
      rmin=roznica;
    }
  }
  oldCena = newCena;
  
  display.setTextSize(1);
  display.print("Last: ");
  display.println(roznica);
  display.print("Min: ");
  display.println(rmin);
  display.print("Max: ");
  display.println(rmax); 
  display.drawBitmap(40, 0, myBitmap, 128, 64, WHITE);
  display.display(); 
  
  delay(30000);

  display.clearDisplay();
  display.setTextSize(3);
  display.setCursor(0, 10);
  
  strftime(buffer,80,"%R",timeinfo);
  display.println(buffer);
  display.setTextSize(1);
  strftime(buffer,80,"%F",timeinfo);
  display.println(buffer);
  display.print("BTC vol: ");
  display.println(volume);
  
  delay(30000);
}
